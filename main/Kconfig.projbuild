## main/Kconfig.projbuild
```kconfig
menu "Rotom Controller Configuration"

    menu "JOYSTICK"
        config JOYSTICK_AXIS_X
            int "Joystick Position of X-axis"
            default 6
            help
                GPIO number for ADC line (0-9).

        config JOYSTICK_AXIS_Y
            int "Joystick Position of Y-axis"
            default 7
            help
                GPIO number for ADC line (0-9).
        
        config JOYSTICK_BUTTON
            int "Joystick button"
            default 32
            help
                GPIO number for external interrupt.
        
        config PAIRING_BUTTON
            int "Pairing button"
            default 16
            help
                GPIO number for external interrupt.
        
        config BRAKE_BUTTON
            int "Brake mode button"
            default 17
            help
                GPIO number for external interrupt.
    endmenu

    menu "I2C Master"
        config I2C_MASTER_SCL
            int "SCL GPIO Num"
            default 19
            help
                GPIO number for I2C Master clock line.

        config I2C_MASTER_SDA
            int "SDA GPIO Num"
            default 18
            help
                GPIO number for I2C Master data line.

        config I2C_MASTER_PORT_NUM
            int "Port Number"
            default 1
            help
                Port number for I2C Master device.

        config I2C_MASTER_FREQUENCY
            int "Master Frequency"
            default 100000
            help
                I2C Speed of Master device.
    endmenu
endmenu
```
